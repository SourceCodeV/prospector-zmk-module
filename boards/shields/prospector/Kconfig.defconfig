## boards/shields/prospector/Kconfig.defconfig
```kconfig
# Dongle 

if SHIELD_PROSPECTOR_DONGLE || SHIELD_PROSPECTOR_CENTRAL

config ZMK_KEYBOARD_NAME
    default "Prospector"

config ZMK_SPLIT_ROLE_CENTRAL
    default y

endif

if SHIELD_PPROSPECTOR_DONGLE || SHIELD_PROSPECTOR_CENTRAL

config ZMK_SPLIT
    default y

endif
```

## boards/shields/prospector/Kconfig.shield
```kconfig
config SHIELD_PROSPECTOR
    bool

config SHIELD_PROSPECTOR_DONGLE
    def_bool $(shields_list_contains,PROSPECTOR_dongle)
    select ZMK_SPLIT_ROLE_CENTRAL
    select ZMK_SPLIT
    select SHIELD_PROSPECTOR

config SHIELD_PROSPECTOR_CENTRAL
    def_bool $(shields_list_contains,PROSPECTOR_central)
    select ZMK_SPLIT_ROLE_CENTRAL
    select ZMK_SPLIT
    select SHIELD_PROSPECTOR
```
